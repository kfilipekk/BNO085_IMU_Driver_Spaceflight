## sdkconfig.defaults
```kconfig
# BNO085 Driver Test Configuration

# Component configuration
CONFIG_FREERTOS_HZ=1000

# ESP32 Configuration
CONFIG_ESP32_DEFAULT_CPU_FREQ_240=y
CONFIG_ESP32_DEFAULT_CPU_FREQ_MHZ=240

# I2C Configuration  
CONFIG_I2C_ENABLE_DEBUG_LOG=y

# Log Configuration
CONFIG_LOG_DEFAULT_LEVEL_INFO=y
CONFIG_LOG_DEFAULT_LEVEL=3
CONFIG_LOG_MAXIMUM_EQUALS_DEFAULT=y
CONFIG_LOG_MAXIMUM_LEVEL=5

# Serial Monitor Configuration
CONFIG_ESP_CONSOLE_UART_DEFAULT=y
CONFIG_ESP_CONSOLE_UART_NUM=0
CONFIG_ESP_CONSOLE_UART_BAUDRATE_115200=y
CONFIG_ESP_CONSOLE_UART_BAUDRATE=115200
```
